/*
 * Copyright (c) 2022 The ZMK Contributors
 *
 * SPDX-License-Identifier: MIT
 */
/ {
    chosen {
        zmk,kscan = &kscan0;
    };

    kscan0: kscan_0 {
        compatible = "zmk,kscan-gpio-matrix";
        diode-direction = "col2row";
        wakeup-source;

        col-gpios
            = <&nice_nano_v2 5 (GPIO_ACTIVE_HIGH | GPIO_PULL_DOWN)>
            , <&nice_nano_v2 6 (GPIO_ACTIVE_HIGH | GPIO_PULL_DOWN)>
            , <&nice_nano_v2 7 (GPIO_ACTIVE_HIGH | GPIO_PULL_DOWN)>
            , <&nice_nano_v2 8 (GPIO_ACTIVE_HIGH | GPIO_PULL_DOWN)>
            , <&nice_nano_v2 9 (GPIO_ACTIVE_HIGH | GPIO_PULL_DOWN)>
            , <&nice_nano_v2 10 (GPIO_ACTIVE_HIGH | GPIO_PULL_DOWN)>
            , <&nice_nano_v2 16 (GPIO_ACTIVE_HIGH | GPIO_PULL_DOWN)>
            , <&nice_nano_v2 14 (GPIO_ACTIVE_HIGH | GPIO_PULL_DOWN)>
            , <&nice_nano_v2 15 (GPIO_ACTIVE_HIGH | GPIO_PULL_DOWN)>
            , <&nice_nano_v2 18 (GPIO_ACTIVE_HIGH | GPIO_PULL_DOWN)>
            ;

        row-gpios
            = <&nice_nano_v2 4 GPIO_ACTIVE_HIGH>
            , <&nice_nano_v2 1 GPIO_ACTIVE_HIGH>
            , <&nice_nano_v2 0 GPIO_ACTIVE_HIGH>
            , <&nice_nano_v2 2 GPIO_ACTIVE_HIGH>
            , <&nice_nano_v2 3 GPIO_ACTIVE_HIGH>
            ;
    };
};
